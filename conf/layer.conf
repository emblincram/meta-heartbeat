## conf/layer.conf
```bitbake
# SPDX-License-Identifier: MIT
# SPDX-Author: Roman Koch <koch.romam@gmail.com>
# SPDX-Copyright: 2024 Roman Koch <koch.romam@gmail.com>

# We have a conf and classes directory, add to BBPATH
BBPATH .= ":${LAYERDIR}"

# We have recipes-* directories, add to BBFILES
BBFILES += "${LAYERDIR}/recipes-*/*/*.bb \
            ${LAYERDIR}/recipes-*/*/*.bbappend"

BBFILE_COLLECTIONS += "meta-heartbeat"
BBFILE_PATTERN_meta-heartbeat = "^${LAYERDIR}/"
BBFILE_PRIORITY_meta-heartbeat = "6"

# bitbake -e | grep "^DISTRO_CODENAME="
LAYERDEPENDS_meta-heartbeat = "core"
LAYERSERIES_COMPAT_meta-heartbeat = "kirkstone"
```
